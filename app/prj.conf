## CMakeLists.txt
```
#
# Copyright (c) 2024 Tareq Mhisen
#
# SPDX-License-Identifier: Apache-2.0
#

cmake_minimum_required(VERSION 3.20.0)

find_package(Zephyr REQUIRED HINTS $ENV{ZEPHYR_BASE})
project(app LANGUAGES C)

target_sources(app PRIVATE
    src/main.c
    src/humidity_temperature_svc.c
    src/user_interface.c
    src/zigbee_svc.c
)
```

## Kconfig
```
#
# Copyright (c) 2024 Tareq Mhisen
#
# SPDX-License-Identifier: Apache-2.0
#

mainmenu "Environmental Sensor Application"

menu "Application configuration"

menu "Zigbee service"


config MEASURING_PERIOD_SECONDS
    int "Sampling period for temperature and humidity measurements (in seconds)"
    default 60
    help
        Defines how frequently the sensor samples temperature and humidity data. Adjust this value to balance between data freshness and power consumption.

config FIRST_MEASUREMENT_DELAY_SECONDS
    int "Delay before the first measurement after device startup (in seconds)"
    default 10
    help
        Specifies the time to wait after booting before taking the initial measurement. This allows the device to stabilize before collecting data.

config NWK_ED_DEVICE_TIMEOUT_INDEX
    int "Index representing the end device timeout period"
    default 12
    help
        Corresponds to the timeout duration in minutes for the End Device Timeout Request command sent by an end device to inform its parent of its timeout requirements.
        For example, an index of 12 equals 4096 minutes. This setting allows the parent to remove the child from the neighbor table if it hasn't communicated within the specified time.

config KEEP_ALIVE_PERIOD_SECONDS
    int "Interval for sending keep-alive messages to the parent device (in seconds)"
    default 81920
    help
        Defines how often the end device sends keep-alive messages to its parent (e.g., a router or coordinator) to ensure it remains in the neighbor table.
        It's recommended to send approximately three keep-alive messages during the End Device Timeout period to maintain connectivity.

config LONG_POLL_PERIOD_SECONDS
    int "Interval at which a Sleepy End Device polls its parent for pending messages (in seconds)"
    default 61440
    help
        Determines how frequently a Sleepy End Device wakes up to check with its parent device for any pending messages.
        Adjusting this interval affects the device's responsiveness to incoming messages and its power consumption.
        It's recommended to set this period shorter than one-third of the End Device Timeout period to prevent unexpected device aging.

config SENSOR_INIT_BASIC_MANUF_NAME
    string "Manufacturer name of the Zigbee device (maximum 32 characters)"
    default "SHAM_TBZ"
    help
        Specifies the manufacturer name for the device's basic cluster. This information is used in device identification and should not exceed 32 characters.

config SENSOR_INIT_BASIC_MODEL_ID
    string "Model identifier assigned by the manufacturer (maximum 32 characters)"
    default "Environmental Sensor 0.0.1"
    help
        Defines the model identifier for the device's basic cluster. This helps in distinguishing different models and should be concise, not exceeding 32 characters.

endmenu

endmenu


source "Kconfig.zephyr"
```

## prj.conf
```kconfig
#
# Copyright (c) 2024 Tareq Mhisen
#
# SPDX-License-Identifier: Apache-2.0
#

#
# LOGGING
#
CONFIG_LOG=y
CONFIG_CONSOLE=y
CONFIG_SERIAL=y
CONFIG_UART_LINE_CTRL=y
```

## src/main.c
```c
/*
 * Copyright (c) 2024 Tareq Mhisen
 *
 * SPDX-License-Identifier: Apache-2.0
 */

#include <zephyr/logging/log.h>

#include "humidity_temperature_svc.h"
#include "zigbee_svc.h"

LOG_MODULE_REGISTER(main, LOG_LEVEL_INF);

int main(void)
{
	int ret;

	LOG_INF("Starting up .. .. ..");

	ret = humidity_temperature_svc_init();
	if (ret != 0) {
		LOG_ERR("Failed to initialize humidity and temperature service!");
	}

	zigbee_svc_init();

	zigbee_svc_start();

	return 0;
}
```

## src/humidity_temperature_svc.c
```c
/*
 * Copyright (c) 2024 Tareq Mhisen
 *
 * SPDX-License-Identifier: Apache-2.0
 */

#include <zephyr/device.h>
#include <zephyr/kernel.h>

#include "zb_environmental_sensor.h"

#include "humidity_temperature_svc.h"

#include <zephyr/logging/log.h>

LOG_MODULE_REGISTER(humidity_temperature_svc, LOG_LEVEL_DBG);

static const struct device *const rh_temp_dev = DEVICE_DT_GET_ONE(sensirion_sht3xd);

struct humidity_temperature_data {
	struct sensor_value humidity;
	struct sensor_value temperature;
};

static struct humidity_temperature_data data;

int humidity_temperature_svc_trigger_measurement(void)
{
	int ret;

	ret = sensor_sample_fetch(rh_temp_dev);
	if (ret != 0) {
		return ret;
	}

	return 0;
}

int humidity_temperature_svc_update_zb_attributes(void)
{
	int ret = 0;
	float measured_temperature = 0.0f;
	float measured_humidity = 0.0f;
	int16_t temperature_attribute = 0;
	int16_t humidity_attribute = 0;

	ret = sensor_channel_get(rh_temp_dev, SENSOR_CHAN_AMBIENT_TEMP, &data.temperature);
	if (ret) {
		LOG_ERR("Failed to get sensor channel: %d", ret);
	} else {
		LOG_DBG("Temperature: %3d.%06d [°C]", data.temperature.val1, data.temperature.val2);
		measured_temperature = sensor_value_to_float(&data.temperature);
		/* Convert measured value to attribute value, as specified in ZCL */
		temperature_attribute =
			(int16_t)(measured_temperature *
				  ZCL_TEMPERATURE_MEASUREMENT_MEASURED_VALUE_MULTIPLIER);

		/* Set ZCL attribute */
		zb_zcl_status_t status = zb_zcl_set_attr_val(
			ENVIRONMENTAL_SENSOR_ENDPOINT_NB, ZB_ZCL_CLUSTER_ID_TEMP_MEASUREMENT,
			ZB_ZCL_CLUSTER_SERVER_ROLE, ZB_ZCL_ATTR_TEMP_MEASUREMENT_VALUE_ID,
			(zb_uint8_t *)&temperature_attribute, ZB_FALSE);
		if (status) {
			LOG_ERR("Failed to set ZCL attribute: %d", status);
			ret = status;
		}
	}

	ret = sensor_channel_get(rh_temp_dev, SENSOR_CHAN_HUMIDITY, &data.humidity);
	if (ret) {
		LOG_ERR("Failed to get sensor channel: %d", ret);
	} else {
		LOG_DBG("Humidity: %3d.%06d [%%]", data.humidity.val1, data.humidity.val2);
		measured_humidity = sensor_value_to_float(&data.humidity);
		/* Convert measured value to attribute value, as specified in ZCL */
		humidity_attribute = (int16_t)(measured_humidity *
					       ZCL_HUMIDITY_MEASUREMENT_MEASURED_VALUE_MULTIPLIER);

		/* Set ZCL attribute */
		zb_zcl_status_t status = zb_zcl_set_attr_val(
			ENVIRONMENTAL_SENSOR_ENDPOINT_NB,
			ZB_ZCL_CLUSTER_ID_REL_HUMIDITY_MEASUREMENT, ZB_ZCL_CLUSTER_SERVER_ROLE,
			ZB_ZCL_ATTR_REL_HUMIDITY_MEASUREMENT_VALUE_ID,
			(zb_uint8_t *)&humidity_attribute, ZB_FALSE);
		if (status) {
			LOG_ERR("Failed to set ZCL attribute: %d", status);
			ret = status;
		}
	}

	return ret;
}

int humidity_temperature_svc_init(void)
{
	if (!device_is_ready(rh_temp_dev)) {
		LOG_ERR("Failed to initialize humidity and temperature sensor!");
		return -ENODEV;
	}

	LOG_DBG("Humidity and temperature sensor initialized successfully");
	return 0;
}
```

## src/humidity_temperature_svc.h
```c
/*
 * Copyright (c) 2024 Tareq Mhisen
 *
 * SPDX-License-Identifier: Apache-2.0
 */

#ifndef APP_ENVIRONMENTAL_SENSORS_H_
#define APP_ENVIRONMENTAL_SENSORS_H_

#include <zephyr/drivers/sensor.h>

/* Measurements ranges for SHT40 sensor */
#define SENSOR_TEMP_CELSIUS_MIN       -40
#define SENSOR_TEMP_CELSIUS_MAX       125
#define SENSOR_TEMP_CELSIUS_TOLERANCE 0.2
#define SENSOR_HUMIDITY_PERCENT_MIN   0
#define SENSOR_HUMIDITY_PERCENT_MAX   100

/**
 * @brief Triggers a new measurement for humidity and temperature.
 *
 * @return 0 on success, or a negative error code if the measurement fails.
 */
int humidity_temperature_svc_trigger_measurement(void);

/**
 * @brief Updates the Zigbee attributes for temperature and humidity.
 *
 * @details This function reads the temperature and humidity values from the sensor, converts them
 *          to the Zigbee ZCL attribute format, and updates the corresponding ZCL attributes.
 *
 * @return 0 on success, or an error code if an error occurs.
 */
int humidity_temperature_svc_update_zb_attributes(void);

/**
 * @brief Initialize the humidity and temperature sensor.
 *
 * @return 0 on success, or -ENODEV on failure
 */
int humidity_temperature_svc_init(void);

#endif /* APP_ENVIRONMENTAL_SENSORS_H_ */
```

## src/user_interface.c
```c
/*
 * Copyright (c) 2024 Tareq Mhisen
 *
 * SPDX-License-Identifier: Apache-2.0
 */

#include <zephyr/kernel.h>
#include <zephyr/device.h>
#include <zephyr/devicetree.h>
#include <zephyr/drivers/gpio.h>

#include "user_interface.h"

#include <zephyr/logging/log.h>

LOG_MODULE_REGISTER(user_interface, LOG_LEVEL_DBG);

static const struct gpio_dt_spec user_button = GPIO_DT_SPEC_GET(DT_ALIAS(sw0), gpios);
static const struct gpio_dt_spec status_led = GPIO_DT_SPEC_GET(DT_ALIAS(led0), gpios);

static struct gpio_callback user_button_cb_data;
static void (*button_callback)(enum button_evt evt) = NULL;
static enum button_evt btn_evt;

static void timer_expiry_fn(struct k_timer *timer)
{
	/* 1 = pressed, 0 = released */
	int button_state = gpio_pin_get_dt(&user_button);
	if (button_state < 0) {
		LOG_ERR("Failed to read user button state: %d", button_state);
		return;
	}
	/* Check if the button is still pressed after 5 seconds */
	if (button_state == 1) {
		btn_evt = BUTTON_EVT_PRESSED_MORE_THAN_5_SEC;
	}
}
static K_TIMER_DEFINE(btn_timer, timer_expiry_fn, NULL);

static void button_handler(struct k_work *work)
{
	ARG_UNUSED(work);
	if (button_callback) {
		/* 1 = pressed, 0 = released */
		int button_state = gpio_pin_get_dt(&user_button);
		if (button_state < 0) {
			LOG_ERR("Failed to read user button state: %d", button_state);
			return;
		}
		if (button_state == 1) {
			btn_evt = BUTTON_EVT_PRESSED_LESS_THAN_5_SEC;
			k_timer_start(&btn_timer, K_SECONDS(5), K_NO_WAIT);
		} else {
			k_timer_stop(&btn_timer); /* Has no effect if the timer was not running */
			if (btn_evt == BUTTON_EVT_PRESSED_MORE_THAN_5_SEC) {
				btn_evt = BUTTON_EVT_RELEASED_AFTER_5_SEC;
			} else {
				btn_evt = BUTTON_EVT_RELEASED_BEFORE_5_SEC;
			}
			button_callback(btn_evt);
		}
	} else {
		LOG_WRN("No registered user button callback!");
	}
}
static K_WORK_DELAYABLE_DEFINE(debouncing_work, button_handler);

static void button_pressed_callback(const struct device *dev, struct gpio_callback *cb,
				    uint32_t pins)
{
	/* Debounce the button */
	k_work_reschedule(&debouncing_work, K_MSEC(15));
}

void ui_register_button_callback(void (*callback)(enum button_evt evt))
{
	button_callback = callback;
}

int ui_toggle_status_led(void)
{
	return gpio_pin_toggle_dt(&status_led);
}

int ui_set_status_led_on(void)
{
	return gpio_pin_set_dt(&status_led, 1);
}

int ui_set_status_led_off(void)
{
	return gpio_pin_set_dt(&status_led, 0);
}

int ui_gpio_init(void)
{
	int ret;

	if (!gpio_is_ready_dt(&status_led)) {
		LOG_ERR("Status LED device not ready");
		return -ENODEV;
	}

	if (!gpio_is_ready_dt(&user_button)) {
		LOG_ERR("User button device not ready");
		return -ENODEV;
	}

	ret = gpio_pin_configure_dt(&status_led, GPIO_OUTPUT_INACTIVE | GPIO_PULL_UP);
	if (ret < 0) {
		LOG_ERR("Failed to configure status LED: %d", ret);
		return ret;
	}

	ret = gpio_pin_configure_dt(&user_button, GPIO_INPUT | GPIO_PULL_UP);
	if (ret < 0) {
		LOG_ERR("Failed to configure user button: %d", ret);
		return ret;
	}

	ret = gpio_pin_interrupt_configure_dt(&user_button, GPIO_INT_EDGE_BOTH);
	if (ret < 0) {
		LOG_ERR("Failed to configure button interrupt: %d", ret);
		return ret;
	}

	gpio_init_callback(&user_button_cb_data, button_pressed_callback, BIT(user_button.pin));

	ret = gpio_add_callback(user_button.port, &user_button_cb_data);
	if (ret < 0) {
		LOG_ERR("Failed to add button callback: %d", ret);
		return ret;
	}

	btn_evt = BUTTON_EVT_NONE;
	LOG_INF("GPIOs initialized successfully");

	return 0;
}
```

## src/user_interface.h
```c
/*
 * Copyright (c) 2024 Tareq Mhisen
 *
 * SPDX-License-Identifier: Apache-2.0
 */

#ifndef APP_USER_INTERFACE_H_
#define APP_USER_INTERFACE_H_

enum button_evt {
	BUTTON_EVT_NONE,
	BUTTON_EVT_PRESSED_LESS_THAN_5_SEC,
	BUTTON_EVT_PRESSED_MORE_THAN_5_SEC,
	BUTTON_EVT_RELEASED_BEFORE_5_SEC,
	BUTTON_EVT_RELEASED_AFTER_5_SEC
};

/**
 * @brief Register a callback function for the user button.
 *
 * @param callback Function pointer to the user callback function.
 */
void ui_register_button_callback(void (*callback)(enum button_evt evt));

/**
 * @brief Toggle the status LED.
 *
 * @return 0 on success, negative error code on failure.
 */
int ui_toggle_status_led(void);

/**
 * @brief Turn on the status LED.
 *
 * @return 0 on success, negative error code on failure.
 */
int ui_set_status_led_on(void);

/**
 * @brief Turn off the status LED.
 *
 * @return 0 on success, negative error code on failure.
 */
int ui_set_status_led_off(void);

/**
 * @brief Initialize GPIOs for user button and status LED.
 *
 * @return 0 on success, negative error code on failure.
 */
int ui_gpio_init(void);

#endif /* APP_USER_INTERFACE_H_ */
```

## src/zb_environmental_sensor.h
```c
/*
 * Copyright (c) 2022 Nordic Semiconductor ASA
 * Copyright (c) 2024 Tareq Mhisen
 *
 * SPDX-License-Identifier: LicenseRef-Nordic-5-Clause
 * SPDX-License-Identifier: Apache-2.0
 */

#ifndef APP_ENVIRONMENTAL_SENSOR_H
#define APP_ENVIRONMENTAL_SENSOR_H

#include <zcl/zb_zcl_temp_measurement_addons.h>
#include <zcl/zb_zcl_basic_addons.h>

/* Zigbee Cluster Library 4.4.2.2.1.1: MeasuredValue = 100x temperature in degrees Celsius */
#define ZCL_TEMPERATURE_MEASUREMENT_MEASURED_VALUE_MULTIPLIER 100
/* Zigbee Cluster Library 4.7.2.1.1: MeasuredValue = 100x water content in % */
#define ZCL_HUMIDITY_MEASUREMENT_MEASURED_VALUE_MULTIPLIER    100

/* Measurements ranges scaled for attribute values */
#define ENVIRONMENTAL_SENSOR_ATTR_TEMP_MIN                                                         \
	(SENSOR_TEMP_CELSIUS_MIN * ZCL_TEMPERATURE_MEASUREMENT_MEASURED_VALUE_MULTIPLIER)
#define ENVIRONMENTAL_SENSOR_ATTR_TEMP_MAX                                                         \
	(SENSOR_TEMP_CELSIUS_MAX * ZCL_TEMPERATURE_MEASUREMENT_MEASURED_VALUE_MULTIPLIER)
#define ENVIRONMENTAL_SENSOR_ATTR_TEMP_TOLERANCE                                                   \
	(SENSOR_TEMP_CELSIUS_TOLERANCE * ZCL_TEMPERATURE_MEASUREMENT_MEASURED_VALUE_MULTIPLIER)

#define ENVIRONMENTAL_SENSOR_ATTR_HUMIDITY_MIN                                                     \
	(SENSOR_HUMIDITY_PERCENT_MIN * ZCL_HUMIDITY_MEASUREMENT_MEASURED_VALUE_MULTIPLIER)
#define ENVIRONMENTAL_SENSOR_ATTR_HUMIDITY_MAX                                                     \
	(SENSOR_HUMIDITY_PERCENT_MAX * ZCL_HUMIDITY_MEASUREMENT_MEASURED_VALUE_MULTIPLIER)

/* Number chosen for the single endpoint provided by weather station */
#define ENVIRONMENTAL_SENSOR_ENDPOINT_NB 42

/* Temperature sensor device version */
#define ZB_HA_DEVICE_VER_TEMPERATURE_SENSOR       0
/* Basic, identify, temperature, humidity */
#define ZB_HA_ENVIRONMENTAL_SENSOR_IN_CLUSTER_NUM 4

#define ZB_HA_ENVIRONMENTAL_SENSOR_OUT_CLUSTER_NUM 0

/* Temperature, humidity */
#define ZB_HA_ENVIRONMENTAL_SENSOR_REPORT_ATTR_COUNT 2

/** @brief Declare cluster list for environmental sensor device
    @param cluster_list_name - cluster list variable name
    @param basic_attr_list - attribute list for Basic cluster
    @param identify_server_attr_list - server attribute list for Identify cluster
    @param temperature_measurement_attr_list - attribute list for temperature measurement cluster
    @param humidity_measurement_attr_list - attribute list for humidity measurement cluster
 */
#define ZB_HA_DECLARE_ENVIRONMENTAL_SENSOR_CLUSTER_LIST(                                           \
	cluster_list_name, basic_attr_list, identify_server_attr_list,                             \
	temperature_measurement_attr_list, humidity_measurement_attr_list)                         \
	zb_zcl_cluster_desc_t cluster_list_name[] = {                                              \
		ZB_ZCL_CLUSTER_DESC(ZB_ZCL_CLUSTER_ID_BASIC,                                       \
				    ZB_ZCL_ARRAY_SIZE(basic_attr_list, zb_zcl_attr_t),             \
				    (basic_attr_list), ZB_ZCL_CLUSTER_SERVER_ROLE,                 \
				    ZB_ZCL_MANUF_CODE_INVALID),                                    \
		ZB_ZCL_CLUSTER_DESC(ZB_ZCL_CLUSTER_ID_IDENTIFY,                                    \
				    ZB_ZCL_ARRAY_SIZE(identify_server_attr_list, zb_zcl_attr_t),   \
				    (identify_server_attr_list), ZB_ZCL_CLUSTER_SERVER_ROLE,       \
				    ZB_ZCL_MANUF_CODE_INVALID),                                    \
		ZB_ZCL_CLUSTER_DESC(                                                               \
			ZB_ZCL_CLUSTER_ID_TEMP_MEASUREMENT,                                        \
			ZB_ZCL_ARRAY_SIZE(temperature_measurement_attr_list, zb_zcl_attr_t),       \
			(temperature_measurement_attr_list), ZB_ZCL_CLUSTER_SERVER_ROLE,           \
			ZB_ZCL_MANUF_CODE_INVALID),                                                \
		ZB_ZCL_CLUSTER_DESC(                                                               \
			ZB_ZCL_CLUSTER_ID_REL_HUMIDITY_MEASUREMENT,                                \
			ZB_ZCL_ARRAY_SIZE(humidity_measurement_attr_list, zb_zcl_attr_t),          \
			(humidity_measurement_attr_list), ZB_ZCL_CLUSTER_SERVER_ROLE,              \
			ZB_ZCL_MANUF_CODE_INVALID),                                                \
	}

#define ZB_ZCL_DECLARE_ENVIRONMENTAL_SENSOR_DESC(ep_name, ep_id, in_clust_num, out_clust_num)      \
	ZB_DECLARE_SIMPLE_DESC(in_clust_num, out_clust_num);                                       \
	ZB_AF_SIMPLE_DESC_TYPE(in_clust_num, out_clust_num)                                        \
	simple_desc_##ep_name = {ep_id,                                                            \
				 ZB_AF_HA_PROFILE_ID,                                              \
				 ZB_HA_TEMPERATURE_SENSOR_DEVICE_ID,                               \
				 ZB_HA_DEVICE_VER_TEMPERATURE_SENSOR,                              \
				 0,                                                                \
				 in_clust_num,                                                     \
				 out_clust_num,                                                    \
				 {                                                                 \
					 ZB_ZCL_CLUSTER_ID_BASIC,                                  \
					 ZB_ZCL_CLUSTER_ID_IDENTIFY,                               \
					 ZB_ZCL_CLUSTER_ID_TEMP_MEASUREMENT,                       \
					 ZB_ZCL_CLUSTER_ID_REL_HUMIDITY_MEASUREMENT,               \
				 }}

#define ZB_HA_DECLARE_ENVIRONMENTAL_SENSOR_EP(ep_name, ep_id, cluster_list)                        \
	ZB_ZCL_DECLARE_ENVIRONMENTAL_SENSOR_DESC(ep_name, ep_id,                                   \
						 ZB_HA_ENVIRONMENTAL_SENSOR_IN_CLUSTER_NUM,        \
						 ZB_HA_ENVIRONMENTAL_SENSOR_OUT_CLUSTER_NUM);      \
	ZBOSS_DEVICE_DECLARE_REPORTING_CTX(reporting_info##ep_name,                                \
					   ZB_HA_ENVIRONMENTAL_SENSOR_REPORT_ATTR_COUNT);          \
	ZB_AF_DECLARE_ENDPOINT_DESC(                                                               \
		ep_name, ep_id, ZB_AF_HA_PROFILE_ID, 0, NULL,                                      \
		ZB_ZCL_ARRAY_SIZE(cluster_list, zb_zcl_cluster_desc_t), cluster_list,              \
		(zb_af_simple_desc_1_1_t *)&simple_desc_##ep_name,                                 \
		ZB_HA_ENVIRONMENTAL_SENSOR_REPORT_ATTR_COUNT, reporting_info##ep_name, 0, NULL)

/**@brief Temperature Measurement cluster attributes according to ZCL Spec 4.7.2.2.1. */
struct zb_zcl_humidity_measurement_attrs_t {
	zb_uint16_t measure_value;
	zb_uint16_t min_measure_value;
	zb_uint16_t max_measure_value;
};

struct zb_device_ctx {
	zb_zcl_basic_attrs_ext_t basic_attr;
	zb_zcl_identify_attrs_t identify_attr;
	zb_zcl_temp_measurement_attrs_t temp_attrs;
	struct zb_zcl_humidity_measurement_attrs_t humidity_attrs;
};

#endif /* APP_ENVIRONMENTAL_SENSOR_H */
```

## src/zigbee_svc.c
```c
/*
 * Copyright (c) 2024 Tareq Mhisen
 *
 * SPDX-License-Identifier: Apache-2.0
 */

#include <zephyr/kernel.h>
#include <ram_pwrdn.h>

#include <zboss_api.h>
#include <zboss_api_addons.h>
#include <zb_nrf_platform.h>
#include <zigbee/zigbee_app_utils.h>
#include <zigbee/zigbee_error_handler.h>

#include "humidity_temperature_svc.h"
#include "user_interface.h"
#include "zb_environmental_sensor.h"
#include "zigbee_svc.h"

#include <zephyr/logging/log.h>

LOG_MODULE_REGISTER(zigbee_svc, LOG_LEVEL_DBG);

#define MEASUREMENT_PERIOD_MSEC      (1000 * CONFIG_MEASURING_PERIOD_SECONDS)
#define FIRST_MEASUREMENT_DELAY_MSEC (1000 * CONFIG_FIRST_MEASUREMENT_DELAY_SECONDS)
#define KEEP_ALIVE_PERIOD_MSEC       (1000 * CONFIG_KEEP_ALIVE_PERIOD_SECONDS)
#define LONG_POLL_PERIOD_MSEC        (1000 * CONFIG_LONG_POLL_PERIOD_SECONDS)

/* Stores all cluster-related attributes */
static struct zb_device_ctx dev_ctx;

/* Declare attribute list for Basic cluster */
ZB_ZCL_DECLARE_BASIC_ATTRIB_LIST_EXT(basic_attr_list, &dev_ctx.basic_attr.zcl_version, NULL, NULL,
				     NULL, dev_ctx.basic_attr.mf_name, dev_ctx.basic_attr.model_id,
				     dev_ctx.basic_attr.date_code, &dev_ctx.basic_attr.power_source,
				     NULL, NULL, NULL);

/* Declare attribute list for Identify cluster (server). */
ZB_ZCL_DECLARE_IDENTIFY_SERVER_ATTRIB_LIST(identify_server_attr_list,
					   &dev_ctx.identify_attr.identify_time);

/* Declare attribute list for temperature cluster */
ZB_ZCL_DECLARE_TEMP_MEASUREMENT_ATTRIB_LIST(temperature_measurement_attr_list,
					    &dev_ctx.temp_attrs.measure_value,
					    &dev_ctx.temp_attrs.min_measure_value,
					    &dev_ctx.temp_attrs.max_measure_value,
					    &dev_ctx.temp_attrs.tolerance);

/* Declare attribute list for humidity cluster */
ZB_ZCL_DECLARE_REL_HUMIDITY_MEASUREMENT_ATTRIB_LIST(humidity_measurement_attr_list,
						    &dev_ctx.humidity_attrs.measure_value,
						    &dev_ctx.humidity_attrs.min_measure_value,
						    &dev_ctx.humidity_attrs.max_measure_value);

/* Clusters setup */
ZB_HA_DECLARE_ENVIRONMENTAL_SENSOR_CLUSTER_LIST(environmental_sensor_cluster_list, basic_attr_list,
						identify_server_attr_list,
						temperature_measurement_attr_list,
						humidity_measurement_attr_list);

/* Endpoint setup (single) */
ZB_HA_DECLARE_ENVIRONMENTAL_SENSOR_EP(environmental_sensor_ep, ENVIRONMENTAL_SENSOR_ENDPOINT_NB,
				      environmental_sensor_cluster_list);

/* Device context */
ZBOSS_DECLARE_DEVICE_CTX_1_EP(environmental_sensor_ctx, environmental_sensor_ep);

void zigbee_svc_clusters_init(void)
{
	/* Basic cluster attributes */
	dev_ctx.basic_attr.zcl_version = ZB_ZCL_VERSION;
	dev_ctx.basic_attr.power_source = ZB_ZCL_BASIC_POWER_SOURCE_BATTERY;

	/* Use ZB_ZCL_SET_STRING_VAL to set strings, because the first byte
	 * should contain string length without trailing zero.
	 *
	 * For example "test" string will be encoded as:
	 *   [(0x4), 't', 'e', 's', 't']
	 */
	ZB_ZCL_SET_STRING_VAL(dev_ctx.basic_attr.mf_name, CONFIG_SENSOR_INIT_BASIC_MANUF_NAME,
			      ZB_ZCL_STRING_CONST_SIZE(CONFIG_SENSOR_INIT_BASIC_MANUF_NAME));

	ZB_ZCL_SET_STRING_VAL(dev_ctx.basic_attr.model_id, CONFIG_SENSOR_INIT_BASIC_MODEL_ID,
			      ZB_ZCL_STRING_CONST_SIZE(CONFIG_SENSOR_INIT_BASIC_MODEL_ID));

	/* Identify cluster attributes */
	dev_ctx.identify_attr.identify_time = ZB_ZCL_IDENTIFY_IDENTIFY_TIME_DEFAULT_VALUE;

	/* Temperature */
	dev_ctx.temp_attrs.measure_value = ZB_ZCL_ATTR_TEMP_MEASUREMENT_VALUE_UNKNOWN;
	dev_ctx.temp_attrs.min_measure_value = ENVIRONMENTAL_SENSOR_ATTR_TEMP_MIN;
	dev_ctx.temp_attrs.max_measure_value = ENVIRONMENTAL_SENSOR_ATTR_TEMP_MAX;
	dev_ctx.temp_attrs.tolerance = ENVIRONMENTAL_SENSOR_ATTR_TEMP_TOLERANCE;

	/* Humidity */
	dev_ctx.humidity_attrs.measure_value = ZB_ZCL_ATTR_REL_HUMIDITY_MEASUREMENT_VALUE_UNKNOWN;
	dev_ctx.humidity_attrs.min_measure_value = ENVIRONMENTAL_SENSOR_ATTR_HUMIDITY_MIN;
	dev_ctx.humidity_attrs.max_measure_value = ENVIRONMENTAL_SENSOR_ATTR_HUMIDITY_MAX;
}

static void start_identifying(zb_bufid_t bufid)
{
	ZVUNUSED(bufid);

	if (ZB_JOINED()) {
		/*
		 * Check if endpoint is in identifying mode,
		 * if not put desired endpoint in identifying mode.
		 */
		if (dev_ctx.identify_attr.identify_time ==
		    ZB_ZCL_IDENTIFY_IDENTIFY_TIME_DEFAULT_VALUE) {

			zb_ret_t zb_err_code =
				zb_bdb_finding_binding_target(ENVIRONMENTAL_SENSOR_ENDPOINT_NB);

			if (zb_err_code == RET_OK) {
				LOG_DBG("Manually enter identify mode");
			} else if (zb_err_code == RET_INVALID_STATE) {
				LOG_WRN("RET_INVALID_STATE - Cannot enter identify mode");
			} else {
				ZB_ERROR_CHECK(zb_err_code);
			}
		} else {
			LOG_DBG("Manually cancel identify mode");
			zb_bdb_finding_binding_target_cancel();
		}
	} else {
		LOG_WRN("Device not in a network - cannot identify itself");
	}
}

void zigbee_svc_configure_long_poll_interval(void)
{
	/* Ensure the device has joined the network before setting the poll interval */
	if (ZB_JOINED()) {
		zb_zdo_pim_set_long_poll_interval(LONG_POLL_PERIOD_MSEC);
		LOG_DBG("Long Poll interval set to %d ms", LONG_POLL_PERIOD_MSEC);
	} else {
		LOG_WRN("Device is not joined to the network. Cannot set Long Poll interval");
	}
}

/**@brief Function to toggle the identify LED
 *
 * @param  bufid  Unused parameter, required by ZBOSS scheduler API.
 */
static void toggle_identify_led(zb_bufid_t bufid)
{
	int ret = ui_toggle_status_led();
	if (ret != 0) {
		LOG_ERR("Failed to toggle status LED: %d", ret);
	}
	ZB_SCHEDULE_APP_ALARM(toggle_identify_led, bufid, ZB_MILLISECONDS_TO_BEACON_INTERVAL(100));
}

/**@brief Function to handle identify notification events on the first endpoint.
 *
 * @param  bufid  Unused parameter, required by ZBOSS scheduler API.
 */
static void identify_callback(zb_bufid_t bufid)
{
	zb_ret_t zb_err_code;

	if (bufid) {
		/* Schedule a self-scheduling function that will toggle the LED */
		ZB_SCHEDULE_APP_CALLBACK(toggle_identify_led, bufid);
	} else {
		/* Cancel the toggling function alarm and turn off LED */
		zb_err_code = ZB_SCHEDULE_APP_ALARM_CANCEL(toggle_identify_led, ZB_ALARM_ANY_PARAM);
		ZVUNUSED(zb_err_code);

		int ret = ui_set_status_led_off();
		if (ret != 0) {
			LOG_ERR("Failed to turn off status LED: %d", ret);
		}
	}
}

static void start_measuring(zb_bufid_t bufid)
{
	ZVUNUSED(bufid);

	int ret = humidity_temperature_svc_trigger_measurement();

	if (ret) {
		LOG_ERR("Failed to trigger humidity and temperature measurement: %d", ret);
	} else {
		ret = humidity_temperature_svc_update_zb_attributes();
		if (ret) {
			LOG_ERR("Failed to update humidity and temperature attributes: %d", ret);
		}
	}

	zb_ret_t zb_err = ZB_SCHEDULE_APP_ALARM(
		start_measuring, 0, ZB_MILLISECONDS_TO_BEACON_INTERVAL(MEASUREMENT_PERIOD_MSEC));
	if (zb_err) {
		LOG_ERR("Failed to schedule app alarm: %d", zb_err);
	}
}

void zboss_signal_handler(zb_bufid_t bufid)
{
	zb_zdo_app_signal_hdr_t *signal_header = NULL;
	zb_zdo_app_signal_type_t signal = zb_get_app_signal(bufid, &signal_header);
	zb_ret_t status = ZB_GET_APP_SIGNAL_STATUS(bufid);

	switch (signal) {
	case ZB_BDB_SIGNAL_DEVICE_REBOOT:
		/* fall-through */
	case ZB_BDB_SIGNAL_STEERING:
		/* Call default signal handler. */
		ZB_ERROR_CHECK(zigbee_default_signal_handler(bufid));
		if (status == RET_OK) {
			/* Schedule first measurement */
			status = ZB_SCHEDULE_APP_ALARM(
				start_measuring, 0,
				ZB_MILLISECONDS_TO_BEACON_INTERVAL(FIRST_MEASUREMENT_DELAY_MSEC));
			if (status) {
				LOG_ERR("Failed to schedule app alarm: %d", status);
			}

			zigbee_svc_configure_long_poll_interval();
		}
		break;

	default:
		/* Let default signal handler process the signal*/
		ZB_ERROR_CHECK(zigbee_default_signal_handler(bufid));
		break;
	}

	/*
	 * All callbacks should either reuse or free passed buffers.
	 * If bufid == 0, the buffer is invalid (not passed).
	 */
	if (bufid) {
		zb_buf_free(bufid);
	}
}

void zigbee_svc_start(void)
{
	/* Enable Sleepy End Device behavior */
	zb_set_rx_on_when_idle(ZB_FALSE);
	if (IS_ENABLED(CONFIG_RAM_POWER_DOWN_LIBRARY)) {
		power_down_unused_ram();
	}

	zb_set_ed_timeout(CONFIG_NWK_ED_DEVICE_TIMEOUT_INDEX);
	zb_set_keepalive_timeout(ZB_MILLISECONDS_TO_BEACON_INTERVAL(KEEP_ALIVE_PERIOD_MSEC));

	/* Start Zigbee stack */
	zigbee_enable();

	LOG_INF("Zigbee environmental sensor started");
}

void btn_callback(enum button_evt evt)
{
	if (evt == BUTTON_EVT_RELEASED_BEFORE_5_SEC) {
		/* Start identification mode */
		zb_ret_t ret = ZB_SCHEDULE_APP_CALLBACK(start_identifying, 0);
		if (ret) {
			LOG_ERR("Failed to schedule app callback: %d", ret);
		}

		/* Inform default signal handler about user input at the device */
		user_input_indicate();
	}

	if (evt == BUTTON_EVT_RELEASED_AFTER_5_SEC) {
		ZB_SCHEDULE_APP_CALLBACK(zb_bdb_reset_via_local_action, 0);
	}
}

void zigbee_svc_init(void)
{
	if (ui_gpio_init() != 0) {
		LOG_ERR("Failed to initialize GPIOs!");
	}

	ui_register_button_callback(btn_callback);

	/* Register device context (endpoint) */
	ZB_AF_REGISTER_DEVICE_CTX(&environmental_sensor_ctx);

	/* Init Basic and Identify and measurements-related attributes */
	zigbee_svc_clusters_init();

	/* Register callback to identify notifications */
	ZB_AF_SET_IDENTIFY_NOTIFICATION_HANDLER(ENVIRONMENTAL_SENSOR_ENDPOINT_NB,
						identify_callback);
}
```

## src/zigbee_svc.h
```c
/*
 * Copyright (c) 2024 Tareq Mhisen
 *
 * SPDX-License-Identifier: Apache-2.0
 */

#ifndef APP_ZIGBEE_SVC_H
#define APP_ZIGBEE_SVC_H

/**
 * @brief Starts the Zigbee service.
 *
 * @details Function configures the Zigbee device as a Sleepy End Device (SED),
 *          powers down unused RAM if configured, and enables the Zigbee stack.
 */
void zigbee_svc_start(void);

/**
 * @brief Initializes the Zigbee service.
 */
void zigbee_svc_init(void);

#endif /* APP_ZIGBEE_SVC_H */
```
